/*
 * lcd.c - sterownik ILI9341 przez SPI1, wersja blokująca (HAL_SPI_Transmit).
 * Krok A2: inicjalizacja, prostokąty, tekst. DMA i renderer paskowy w kroku A3.
 */
#include "lcd.h"
#include "main.h"
#include "spi.h"

#define CS_LO()  HAL_GPIO_WritePin(CS_DISP_GPIO_Port, CS_DISP_Pin, GPIO_PIN_RESET)
#define CS_HI()  HAL_GPIO_WritePin(CS_DISP_GPIO_Port, CS_DISP_Pin, GPIO_PIN_SET)
#define DC_CMD() HAL_GPIO_WritePin(DC_RS_GPIO_Port, DC_RS_Pin, GPIO_PIN_RESET)
#define DC_DAT() HAL_GPIO_WritePin(DC_RS_GPIO_Port, DC_RS_Pin, GPIO_PIN_SET)

static void spi_tx(const uint8_t *d, uint16_t n)
{
    HAL_SPI_Transmit(&hspi1, (uint8_t *)d, n, HAL_MAX_DELAY);
}

/* Komenda + dane w jednej transakcji (CS niski przez cały czas) */
static void lcd_cmd(uint8_t cmd, const uint8_t *data, uint16_t n)
{
    CS_LO();
    DC_CMD();
    spi_tx(&cmd, 1);
    if (n) {
        DC_DAT();
        spi_tx(data, n);
    }
    CS_HI();
}

/* Sekwencja inicjalizacji: {komenda, liczba bajtów, dane...}; 0x80 w liczbie = opóźnienie 150 ms */
static const uint8_t init_seq[] = {
    0xEF, 3, 0x03, 0x80, 0x02,
    0xCF, 3, 0x00, 0xC1, 0x30,
    0xED, 4, 0x64, 0x03, 0x12, 0x81,
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    0xC7, 1, 0x86,              /* VCOM control 2 */
    0x36, 1, LCD_MADCTL,        /* orientacja */
    0x37, 1, 0x00,              /* przewijanie pionowe = 0 */
    0x3A, 1, 0x55,              /* 16 bit/piksel (RGB565) */
    0xB1, 2, 0x00, 0x18,        /* częstotliwość odświeżania ~79 Hz */
    0xB6, 3, 0x08, 0x82, 0x27,  /* Display function control */
    0xF2, 1, 0x00,              /* 3-gamma wyłączona */
    0x26, 1, 0x01,              /* krzywa gamma 1 */
    0xE0, 15, 0x0F, 0x31, 0x2B, 0x0C, 0x0E, 0x08, 0x4E, 0xF1, 0x37, 0x07, 0x10, 0x03, 0x0E, 0x09, 0x00,
    0xE1, 15, 0x00, 0x0E, 0x14, 0x03, 0x11, 0x07, 0x31, 0xC1, 0x48, 0x08, 0x0F, 0x0C, 0x31, 0x36, 0x0F,
    0x11, 0x80,                 /* Sleep out + 150 ms */
    0x29, 0x80,                 /* Display on + 150 ms */
    0x00                        /* koniec */
};

void lcd_init(void)
{
    CS_HI();
    /* reset sprzętowy */
    HAL_GPIO_WritePin(RESET_GPIO_Port, RESET_Pin, GPIO_PIN_SET);
    HAL_Delay(5);
    HAL_GPIO_WritePin(RESET_GPIO_Port, RESET_Pin, GPIO_PIN_RESET);
    HAL_Delay(20);
    HAL_GPIO_WritePin(RESET_GPIO_Port, RESET_Pin, GPIO_PIN_SET);
    HAL_Delay(150);

    const uint8_t *p = init_seq;
    while (*p) {
        uint8_t cmd = *p++;
        uint8_t n = *p++;
        lcd_cmd(cmd, p, n & 0x7F);
        p += n & 0x7F;
        if (n & 0x80) HAL_Delay(150);
    }
}

void lcd_set_window(uint16_t x0, uint16_t y0, uint16_t x1, uint16_t y1)
{
    uint8_t c[4] = { x0 >> 8, x0 & 0xFF, x1 >> 8, x1 & 0xFF };
    uint8_t r[4] = { y0 >> 8, y0 & 0xFF, y1 >> 8, y1 & 0xFF };
    lcd_cmd(0x2A, c, 4);   /* CASET - kolumny */
    lcd_cmd(0x2B, r, 4);   /* PASET - wiersze */
}

/* Wysyła n pikseli jednego koloru (po ustawieniu okna) */
static void lcd_push_color(uint16_t color, uint32_t n)
{
    static uint8_t buf[2 * LCD_W];
    for (uint16_t i = 0; i < LCD_W; i++) {
        buf[2 * i] = color >> 8;
        buf[2 * i + 1] = color & 0xFF;
    }
    uint8_t cmd = 0x2C;    /* RAMWR */
    CS_LO();
    DC_CMD();
    spi_tx(&cmd, 1);
    DC_DAT();
    while (n) {
        uint32_t k = n > LCD_W ? LCD_W : n;
        spi_tx(buf, (uint16_t)(2 * k));
        n -= k;
    }
    CS_HI();
}

void lcd_fill_rect(uint16_t x, uint16_t y, uint16_t w, uint16_t h, uint16_t color)
{
    if (x >= LCD_W || y >= LCD_H || w == 0 || h == 0) return;
    if (x + w > LCD_W) w = LCD_W - x;
    if (y + h > LCD_H) h = LCD_H - y;
    lcd_set_window(x, y, x + w - 1, y + h - 1);
    lcd_push_color(color, (uint32_t)w * h);
}

void lcd_fill(uint16_t color)
{
    lcd_fill_rect(0, 0, LCD_W, LCD_H, color);
}

void lcd_pixel(uint16_t x, uint16_t y, uint16_t color)
{
    lcd_fill_rect(x, y, 1, 1, color);
}

/* Czcionka 5x7, znaki 0x20..0x7E, kolumny, bit 0 = górny wiersz */
static const uint8_t font5x7[95][5] = {
    {0x00,0x00,0x00,0x00,0x00},{0x00,0x00,0x5F,0x00,0x00},{0x00,0x07,0x00,0x07,0x00},{0x14,0x7F,0x14,0x7F,0x14}, /*  !"# */
    {0x24,0x2A,0x7F,0x2A,0x12},{0x23,0x13,0x08,0x64,0x62},{0x36,0x49,0x56,0x20,0x50},{0x00,0x00,0x07,0x00,0x00}, /* $%&' */
    {0x00,0x1C,0x22,0x41,0x00},{0x00,0x41,0x22,0x1C,0x00},{0x2A,0x1C,0x7F,0x1C,0x2A},{0x08,0x08,0x3E,0x08,0x08}, /* ()*+ */
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    {0x00,0x00,0x7F,0x00,0x00},{0x00,0x41,0x36,0x08,0x00},{0x10,0x08,0x08,0x10,0x08}                             /* |}~  */
};

/* Wzór znaku 5x7 (5 kolumn, bit 0 = górny wiersz) - także dla tekstu rysowanego w paskach (gfx.c) */
const uint8_t *lcd_glyph(char ch)
{
    if (ch < 0x20 || ch > 0x7E) ch = '?';
    return font5x7[ch - 0x20];
}

/* Jeden znak: bufor komórki 6x8 * scale, wysłany jednym oknem */
static void lcd_char(uint16_t x, uint16_t y, char ch, uint16_t fg, uint16_t bg, uint8_t s)
{
    static uint8_t buf[6 * 8 * 4 * 4 * 2];       /* do scale = 4 */
    if (s < 1) s = 1;
    if (s > 4) s = 4;
    if (ch < 0x20 || ch > 0x7E) ch = '?';
    const uint8_t *g = font5x7[ch - 0x20];
    uint16_t w = 6 * s, h = 8 * s;
    if (x + w > LCD_W || y + h > LCD_H) return;

    uint32_t k = 0;
    for (uint16_t py = 0; py < h; py++) {
        uint8_t row = py / s;
        for (uint16_t px = 0; px < w; px++) {
            uint8_t col = px / s;
            uint8_t on = (col < 5) && (row < 7) && (g[col] >> row & 1);
            uint16_t c = on ? fg : bg;
            buf[k++] = c >> 8;
            buf[k++] = c & 0xFF;
        }
    }
    lcd_set_window(x, y, x + w - 1, y + h - 1);
    uint8_t cmd = 0x2C;
    CS_LO();
    DC_CMD();
    spi_tx(&cmd, 1);
    DC_DAT();
    spi_tx(buf, (uint16_t)k);
    CS_HI();
}

/* Zapis ciągły do okna: CS zostaje niski, DC = dane, piksele wysyła DMA (gfx.c) */
void lcd_begin_write(uint16_t x0, uint16_t y0, uint16_t x1, uint16_t y1)
{
    lcd_set_window(x0, y0, x1, y1);
    uint8_t cmd = 0x2C;
    CS_LO();
    DC_CMD();
    spi_tx(&cmd, 1);
    DC_DAT();
}

void lcd_end_write(void)
{
    CS_HI();
}

void lcd_text(uint16_t x, uint16_t y, const char *s, uint16_t fg, uint16_t bg, uint8_t scale)
{
    while (*s) {
        lcd_char(x, y, *s++, fg, bg, scale);
        x += 6 * scale;
    }
}
